/*###ICF### Section handled by ICF editor, don't touch! ****/
/*-Editor annotation file-*/
/* IcfEditorFile="$TOOLKIT_DIR$\config\ide\IcfEditor\a_v1_0.xml" */
/*-Specials-*/
define symbol __ICFEDIT_intvec_start__ = 0x20000000;
/*-Memory Regions-*/
define symbol __ICFEDIT_region_ROM_start__ = 0x080030ec;
define symbol __ICFEDIT_region_ROM_end__   = 0x0801FFFF;
define symbol __ICFEDIT_region_RAM_start__ = 0x20000000;
// ★ FLASH 実行時の RAM サイズを引いたものを設定
define symbol __ICFEDIT_region_RAM_end__   = 0x20004FFF - 0x001C;
/*-Sizes-*/
define symbol __ICFEDIT_size_cstack__ = 0x0;
define symbol __ICFEDIT_size_heap__   = 0x200;
/**** End of ICF editor section. ###ICF###*/

define memory mem with size = 4G;
define region ROM_region   = mem:[from __ICFEDIT_region_ROM_start__   to __ICFEDIT_region_ROM_end__];
define region RAM_region   = mem:[from __ICFEDIT_region_RAM_start__   to __ICFEDIT_region_RAM_end__];

define block CSTACK    with alignment = 4, size = __ICFEDIT_size_cstack__   { };
place at address mem:( __ICFEDIT_region_RAM_end__ + 1 ) { block CSTACK, section FLASH_DATA };

define block HEAP      with alignment = 4, size = __ICFEDIT_size_heap__     { };

//initialize by copy { readwrite };
do not initialize  { readwrite, section .noinit };

place at address mem:__ICFEDIT_region_ROM_start__ { section FLASH_CODE };
place at address mem:__ICFEDIT_intvec_start__ { };

define block RAM_Block with fixed order { section .intvec, readonly, rw, block HEAP, section .BottomOfSram };

//place in ROM_region   { readonly };
place in RAM_region   { block RAM_Block };
